## conf/layer.conf
```bitbake
# mbed linux layer configuration file
BBPATH .= ":${LAYERDIR}"

# We have a recipes directory, add to BBFILES
BBFILES += "${LAYERDIR}/recipes*/*/*.bb ${LAYERDIR}/recipes*/*/*.bbappend"

BBFILE_COLLECTIONS += "meta-foo"
BBFILE_PATTERN_meta-foo := "^${LAYERDIR}/"
BBFILE_PRIORITY_meta-foo = "8"
```

## conf/machine/imx7s-warp-foo.conf
```bitbake
#@TYPE: Machine
#@NAME: NXP WaRP7 Development Board
#@DESCRIPTION: Machine configuration for the WaRP7 board

MACHINEOVERRIDES = "imx7s-warp:${MACHINE}"
include conf/machine/imx7s-warp.conf

MACHINE_EXTRA_RRECOMMENDS += "linux-firmware-bcm43430"
```
